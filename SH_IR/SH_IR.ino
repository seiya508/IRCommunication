//2020.12.11
// ipload to github 2022.02.09
//AlexaとESP32を連携
//赤外線送受信を行う

#ifdef ARDUINO_ARCH_ESP32
#include <WiFi.h>
#else
#include <ESP8266WiFi.h>
#endif
#include <Espalexa.h>

#include <IRremoteESP8266.h>
#include <IRsend.h>
#include <IRutils.h>


//----------Espalexa設定部----------//
// prototypes
boolean connectWifi();

//callback functions
//new callback type, contains device pointer
//テレビ
void controlTVPower(EspalexaDevice* d);
void controlTVChannel(EspalexaDevice* d);
void controlTVVolume(EspalexaDevice* d);
//エアコン
void controlAC(EspalexaDevice* d);
void controlHeater(EspalexaDevice* d);

// WiFi設定
const char* ssid = "hogehoge";
const char* password = "hogehoge";

boolean wifiConnected = false;

Espalexa espalexa;

//----------赤外線設定部----------
const uint16_t kIrLed = 23; //赤外線LEDのピンを取得
IRsend irsend(kIrLed); // 送信オブジェクトの作成
bool success = true; //送信成功判定

//---テレビの赤外線コード---
// ※適宜解析して変更
decode_type_t protocolTV = SONY;
const uint32_t powerValue = 0xA90;  uint16_t powerSize = 12;  //テレビ電源
//const uint32_t sourceValue = 0xA50; uint16_t sourceSize = 12; //入力切替
//チャンネル(順に#1, #2,...)
//const uint32_t channelValue[12] = {0x010, 0x810, 0x410, 0xC10, 
//                                   0x210, 0xA10, 0x610, 0xE10, 
//                                   0x110, 0x910, 0x510, 0xD10};
//uint16_t channelSize = 12;
const uint32_t channelUpValue = 0x90;    uint16_t channelUpSize = 12;   //チャンネル大
const uint32_t channelDownValue = 0x890; uint16_t channelDownSize = 12; //チャンネル小
//音量
//const uint32_t volumeUpValue = 0x490;   uint16_t volumeUpSize = 12;   //音量大
//const uint32_t volumeDownValue = 0xC90; uint16_t volumeDownSize = 12; //音量小
const uint32_t muteValue = 0x290; uint16_t muteSize = 12; //消音

//---エアコンの赤外線コード---
// ※適宜解析して変更
const uint16_t khz = 38;  //周波数

//冷房(28℃, その他自動) Raw
//const uint16_t acValue[440] = {3504, 1756, 452, 420, 452, 1288, 448, 424, 452, 424, 452, 420, 452,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 1272, 448};
//冷房(26℃, その他自動) Raw
const uint16_t acValue[440] = {3496, 1764, 452, 420, 452, 1288, 448, 424, 452, 424, 452, 424, 448,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 1272, 452};

//暖房(20℃, その他自動) Raw
//const uint16_t heaterValue[440] = {3492, 1772, 424, 440, 432, 1308, 432, 440, 432, 448, 432, 444, 428,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 1272, 444};
//暖房(22℃, その他自動) Raw
const uint16_t heaterValue[440] = {3516, 1740, 456, 416, 456, 1284, 456, 416, 456, 424, 452, 420, 456,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 1268, 452};

//停止 Raw
const uint16_t stopValue[440] = {3536, 1740, 448, 416, 456, 1272, 432, 432, 456, 416, 456, 412, 452,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 1304, 408};


void setup()
{
  Serial.begin(115200);
  
  // Initialise wifi connection
  wifiConnected = connectWifi();
  
  if(wifiConnected){
    
    // Define your devices here. 
    //テレビ
    espalexa.addDevice("TV Power",   controlTVPower,   EspalexaDeviceType::onoff, 0);   //non-dimmable device
    espalexa.addDevice("TV Channel", controlTVChannel, EspalexaDeviceType::onoff, 0);   //non-dimmable device
    espalexa.addDevice("TV Volume",  controlTVVolume,  EspalexaDeviceType::onoff, 255); //non-dimmable device
    //エアコン
    espalexa.addDevice("AC",      controlAC,      EspalexaDeviceType::onoff, 0); //non-dimmable device
    espalexa.addDevice("Heater",  controlHeater,  EspalexaDeviceType::onoff, 0); //non-dimmable device
    
    espalexa.begin();
    Serial.println("Completed");
    
  }else{
    while (1) {
      Serial.println("Cannot connect to WiFi. Please check data and reset the ESP.");
      delay(2500);
    }
  }
  
  irsend.begin();
}
 
void loop()
{
   espalexa.loop();
   delay(1);
}



//our callback functions
//テレビ
void controlTVPower(EspalexaDevice* d){
  if (d == nullptr) return; //this is good practice, but not required

  Serial.print("TV changed to ");
  if (d->getValue()){
    success = irsend.send(protocolTV, powerValue, powerSize); //送信
    if(success){ Serial.println("ON"); }
  }else {
    success = irsend.send(protocolTV, powerValue, powerSize); //送信
    if(success){ Serial.println("OFF"); }
  }
}

void controlTVChannel(EspalexaDevice* d){
  if (d == nullptr) return; //this is good practice, but not required

  Serial.print("TV changed to ");
  if (d->getValue()){
    success = irsend.send(protocolTV, channelUpValue, channelUpSize); //送信
    if(success){ Serial.println("Channel+"); }
  }else {
    success = irsend.send(protocolTV, channelDownValue, channelDownSize); //送信
    if(success){ Serial.println("Channel-"); }
  }
}

void controlTVVolume(EspalexaDevice* d){
  if (d == nullptr) return; //this is good practice, but not required

  Serial.print("TV changed to ");
  if (d->getValue()){
    success = irsend.send(protocolTV, muteValue, muteSize); //送信
    if(success){ Serial.println("Volume ON"); }
  }else {
    success = irsend.send(protocolTV, muteValue, muteSize); //送信
    if(success){ Serial.println("Mute"); }
  }
}

//エアコン
void controlAC(EspalexaDevice* d){
  if (d == nullptr) return; //this is good practice, but not required

  Serial.print("AC changed to ");
  if (d->getValue()){
    
    irsend.sendRaw(acValue, sizeof(acValue) / sizeof(acValue[0]), khz);
    Serial.println("ON");
  }else {

    irsend.sendRaw(stopValue, sizeof(stopValue) / sizeof(stopValue[0]), khz);
    Serial.println("OFF");
  }
}

void controlHeater(EspalexaDevice* d){
  if (d == nullptr) return; //this is good practice, but not required

  Serial.print("Heater changed to ");
  if (d->getValue()){

    irsend.sendRaw(heaterValue, sizeof(heaterValue) / sizeof(heaterValue[0]), khz);
    Serial.println("ON");
  }else {

    irsend.sendRaw(stopValue, sizeof(stopValue) / sizeof(stopValue[0]), khz);
    Serial.println("OFF");
  }
}
  


// connect to wifi – returns true if successful or false if not
boolean connectWifi(){
  boolean state = true;
  int i = 0;
  
  WiFi.mode(WIFI_STA);
  WiFi.begin(ssid, password);
  Serial.println("");
  Serial.println("Connecting to WiFi");

  // Wait for connection
  Serial.print("Connecting...");
  while (WiFi.status() != WL_CONNECTED) {
    delay(500);
    Serial.print(".");
    if (i > 20){
      state = false; break;
    }
    i++;
  }
  Serial.println("");
  if (state){
    Serial.print("Connected to ");
    Serial.println(ssid);
    Serial.print("IP address: ");
    Serial.println(WiFi.localIP());
  }
  else {
    Serial.println("Connection failed.");
  }
  return state;
}
